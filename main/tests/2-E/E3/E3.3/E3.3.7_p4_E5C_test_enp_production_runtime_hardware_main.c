/*
 * E3.3.7_p4_E5C_test_enp_production_runtime_hardware_main.c
 *
 *    Created on: Aug 18, 2026
 *      Author: Pedro Marques 
 * 
 * E3.3.7 Phase 4 / P4-E5C
 * Real ESP-NOW transport failure -> route invalidation hardware validation.
 *
 * Target: ESP-IDF 6.0.2
 *
 * Scope:
 *   Validate that a real ESP-NOW asynchronous transmission failure observed
 *   by the production transport reaches the frozen routing data path and
 *   invalidates every ACTIVE route using the failed logical next-hop.
 *
 * Hardware model:
 *   One ESP32 is sufficient.
 *
 *   The failed next-hop is represented by a deliberately unreachable,
 *   locally-administered MAC address. No second ESP32 is required because
 *   the validation concerns the failure path generated by the local ESP-NOW
 *   transmitter.
 *
 * This test intentionally does not claim validation of:
 *   - successful real ESP-NOW delivery
 *   - RERR
 *   - RREQ/RREP
 *   - route discovery
 *   - route repair
 *   - reliability recovery
 */

#include <stdbool.h>
#include <stddef.h>
#include <stdint.h>
#include <string.h>

#include "esp_err.h"
#include "esp_event.h"
#include "esp_log.h"
#include "esp_netif.h"
#include "esp_now.h"
#include "nvs_flash.h"

#include "freertos/FreeRTOS.h"
#include "freertos/task.h"

#include "config/enp_config.h"
#include "core/enp_context.h"
#include "core/enp_transport.h"
#include "core/protocol/enp_packet.h"
#include "core/routing/enp_route_table.h"
#include "core/routing/enp_routing_data_path.h"
#include "link/enp_transport_espnow.h"
#include "link/enp_transport_wifi.h"

#define P4_E5C_WAIT_MS 10000U

/*
 * IMPORTANT:
 *
 * These addresses must not belong to an active ESP32 or other active
 * ESP-NOW peer during the test.
 *
 * Next-hop 2 is the intentionally unreachable destination which will
 * generate the real ESP-NOW failure used by this validation.
 *
 * Next-hop 3 is only used as an unrelated route identity; no transmission
 * is sent to it.
 */
#define P4_E5C_FAILED_MAC {0x02U, 0x00U, 0x00U, 0xE5U, 0x0CU, 0x5CU}
#define P4_E5C_OTHER_MAC  {0x02U, 0x00U, 0x00U, 0xE5U, 0x0CU, 0x5DU}

static const char *TAG = "E3_3_7_P4_E5C";

static enp_context_t s_context;

static enp_transport_address_t s_failed_mac;
static enp_transport_address_t s_other_mac;

static bool nvs_init(void) {
	esp_err_t err = nvs_flash_init();

	if ((err == ESP_ERR_NVS_NO_FREE_PAGES) ||
		(err == ESP_ERR_NVS_NEW_VERSION_FOUND)) {
		err = nvs_flash_erase();
		if (err != ESP_OK) {
			return false;
		}
		err = nvs_flash_init();
	}

	return err == ESP_OK;
}

static bool wait_for_wifi(void) {
	const TickType_t start = xTaskGetTickCount();

	while (!enp_wifi_is_connected()) {
		vTaskDelay(pdMS_TO_TICKS(100U));

		if ((xTaskGetTickCount() - start) >= pdMS_TO_TICKS(P4_E5C_WAIT_MS)) {
			return false;
		}
	}

	return true;
}

static enp_config_t make_config(void) {
	enp_config_t config = {0};

	config.network_id = 1U;
	config.node_id = 1U;
	config.role = ENP_ROLE_GATEWAY;

	return config;
}

static enp_transport_address_t make_mac(const uint8_t mac[6]) {
	enp_transport_address_t address = {0};

	address.length = 6U;
	memcpy(address.value, mac, 6U);

	return address;
}

static bool address_equal(const enp_transport_address_t *a,
						  const enp_transport_address_t *b) {
	if ((a == NULL) || (b == NULL) || (a->length != b->length)) {
		return false;
	}

	return memcmp(a->value, b->value, a->length) == 0;
}

static void log_address(const char *label,
						const enp_transport_address_t *address) {
	if ((address == NULL) || (address->length != 6U)) {
		ESP_LOGI(TAG, "%s: invalid address", label);
		return;
	}

	ESP_LOGI(TAG, "%s: %02X:%02X:%02X:%02X:%02X:%02X",
			 label,
			 address->value[0], address->value[1], address->value[2],
			 address->value[3], address->value[4], address->value[5]);
}

static bool resolve_transport(void *context,
							  enp_route_destination_t next_hop,
							  enp_transport_address_t *address) {
	(void)context;

	if ((address == NULL) || (next_hop.network_id != 1U)) {
		return false;
	}

	if (next_hop.node_id == 2U) {
		*address = s_failed_mac;
		return true;
	}

	if (next_hop.node_id == 3U) {
		*address = s_other_mac;
		return true;
	}

	return false;
}

static enp_route_entry_t make_route(uint16_t destination,
									uint16_t next_hop,
									uint32_t sequence) {
	enp_route_entry_t entry = {0};

	entry.destination.network_id = 1U;
	entry.destination.node_id = destination;

	entry.next_hop.network_id = 1U;
	entry.next_hop.node_id = next_hop;

	entry.metric.type = ENP_ROUTE_METRIC_HOP_COUNT;
	entry.metric.value = 1U;
	entry.metric.valid = true;

	entry.route_sequence = sequence;
	entry.expires_at_ms = 60000U;
	entry.state = ENP_ROUTE_STATE_ACTIVE;

	return entry;
}

static const enp_route_entry_t *
find_entry(const enp_route_table_t *table, uint16_t node) {
	if (table == NULL) {
		return NULL;
	}

	for (size_t i = 0U; i < table->count; ++i) {
		const enp_route_entry_t *entry = &table->entries[i];

		if ((entry->destination.network_id == 1U) &&
			(entry->destination.node_id == node)) {
			return entry;
		}
	}

	return NULL;
}

static bool route_state(const enp_route_table_t *table,
						uint16_t node,
						enp_route_state_t expected) {
	const enp_route_entry_t *entry = find_entry(table, node);

	return entry != NULL && entry->state == expected;
}

static void check(bool condition, const char *message, bool *all) {
	if (condition) {
		ESP_LOGI(TAG, "PASS: %s", message);
	} else {
		ESP_LOGE(TAG, "FAIL: %s", message);
		*all = false;
	}
}

static bool make_test_packet(enp_packet_t *packet) {
	if (packet == NULL) {
		return false;
	}

	const enp_address_t source = {
		.network = 1U,
		.node = 1U
	};

	enp_packet_init(packet, ENP_PACKET_APPLICATION, &source);

	enp_header_t *header = enp_packet_header(packet);

	if (header == NULL) {
		return false;
	}

	header->destination.network = 1U;
	header->destination.node = 10U;
	header->sequence = 0xE5C10001U;

	static const uint8_t payload[] = "ENP-P4-E5C-HW";

	memcpy(enp_packet_payload(packet), payload, sizeof(payload) - 1U);

	return enp_packet_seal(packet, sizeof(payload) - 1U) == ESP_OK;
}

void app_main(void) {
	bool all = true;

	static const uint8_t failed_mac[6] = P4_E5C_FAILED_MAC;
	static const uint8_t other_mac[6] = P4_E5C_OTHER_MAC;

	s_failed_mac = make_mac(failed_mac);
	s_other_mac = make_mac(other_mac);

	ESP_LOGI(TAG, "======================================");
	ESP_LOGI(TAG, "E3.3.7 PHASE 4 / P4-E5C");
	ESP_LOGI(TAG, "PRODUCTION RUNTIME HARDWARE VALIDATION");
	ESP_LOGI(TAG, "Real ESP-NOW TX failure -> route invalidation");
	ESP_LOGI(TAG, "Target: ESP-IDF 6.0.2");
	ESP_LOGI(TAG, "======================================");

	log_address("Configured failed next-hop MAC", &s_failed_mac);
	log_address("Configured unrelated next-hop MAC", &s_other_mac);

	ESP_LOGI(TAG,
			 "IMPORTANT: neither MAC may belong to an active ESP32/ESP-NOW peer");

	check(nvs_init(), "NVS initialized", &all);

	if (all) {
		check(esp_netif_init() == ESP_OK,
			  "ESP-NETIF initialized", &all);
	}

	if (all) {
		const esp_err_t err = esp_event_loop_create_default();

		check((err == ESP_OK) || (err == ESP_ERR_INVALID_STATE),
			  "default event loop available", &all);
	}

	if (all) {
		check(enp_wifi_init() == ESP_OK, "Wi-Fi initialized", &all);
	}

	if (all) {
		check(wait_for_wifi(), "Wi-Fi connected", &all);

		if (all) {
			ESP_LOGI(TAG, "PASS: Wi-Fi channel=%u",
					 (unsigned)enp_wifi_get_channel());
		}
	}

	enp_transport_t *transport = NULL;

	if (all) {
		transport = enp_transport_espnow_get();

		check(transport != NULL,
			  "real ESP-NOW transport instance available", &all);
	}

	const enp_config_t config = make_config();

	if (all) {
		check(enp_context_init(&s_context, transport, &config) == ESP_OK,
			  "real ESP-NOW transport initialized through ENP context", &all);
	}

	enp_route_table_t routes;
	enp_routing_data_path_t path = {0};

	if (all) {
		check(enp_route_table_init(&routes),
			  "production route table initialized", &all);

		const enp_route_entry_t route_a =
			make_route(10U, 2U, 0xE5C00010U);
		const enp_route_entry_t route_b =
			make_route(11U, 2U, 0xE5C00011U);
		const enp_route_entry_t route_c =
			make_route(12U, 3U, 0xE5C00012U);

		check(enp_route_table_insert(&routes, &route_a),
			  "route A installed: destination 10 via failed next-hop 2",
			  &all);
		check(enp_route_table_insert(&routes, &route_b),
			  "route B installed: destination 11 via failed next-hop 2",
			  &all);
		check(enp_route_table_insert(&routes, &route_c),
			  "route C installed: destination 12 via unrelated next-hop 3",
			  &all);
	}

	if (all) {
		check(enp_routing_data_path_init(&path, &routes, transport,
										 resolve_transport, NULL),
			  "production routing data path initialized", &all);
	}

	if (all) {
		check(route_state(&routes, 10U, ENP_ROUTE_STATE_ACTIVE),
			  "route A initially ACTIVE", &all);
		check(route_state(&routes, 11U, ENP_ROUTE_STATE_ACTIVE),
			  "route B initially ACTIVE", &all);
		check(route_state(&routes, 12U, ENP_ROUTE_STATE_ACTIVE),
			  "unrelated route C initially ACTIVE", &all);
	}

	const enp_route_entry_t *route_a_before = find_entry(&routes, 10U);
	const enp_route_entry_t *route_b_before = find_entry(&routes, 11U);

	const uint32_t sequence_a =
		route_a_before != NULL ? route_a_before->route_sequence : 0U;
	const uint32_t sequence_b =
		route_b_before != NULL ? route_b_before->route_sequence : 0U;

	enp_packet_t packet = {0};

	if (all) {
		check(make_test_packet(&packet),
			  "real DATA packet constructed and sealed", &all);
	}

	if (all) {
		check(enp_routing_data_path_submit(&path, &packet) == ESP_OK,
			  "production routing path submitted real ESP-NOW transmission",
			  &all);
	}

	if (all) {
		const TickType_t start = xTaskGetTickCount();

		while (route_state(&routes, 10U, ENP_ROUTE_STATE_ACTIVE) &&
			   ((xTaskGetTickCount() - start) <
				pdMS_TO_TICKS(P4_E5C_WAIT_MS))) {
			vTaskDelay(pdMS_TO_TICKS(50U));
		}

		check(route_state(&routes, 10U, ENP_ROUTE_STATE_STALE),
			  "real ESP-NOW failure invalidated route A", &all);
		check(route_state(&routes, 11U, ENP_ROUTE_STATE_STALE),
			  "real ESP-NOW failure invalidated route B sharing next-hop 2",
			  &all);
		check(route_state(&routes, 12U, ENP_ROUTE_STATE_ACTIVE),
			  "unrelated route C remained ACTIVE after real failure", &all);
	}

	const enp_route_entry_t *route_a_after = find_entry(&routes, 10U);
	const enp_route_entry_t *route_b_after = find_entry(&routes, 11U);

	if (all) {
		check(route_a_after != NULL &&
				  route_a_after->route_sequence == sequence_a,
			  "route A sequence preserved after real failure", &all);
		check(route_b_after != NULL &&
				  route_b_after->route_sequence == sequence_b,
			  "route B sequence preserved after real failure", &all);
	}

	/*
	 * Generate a second real ESP-NOW failure directly at the transport
	 * boundary. There are no remaining ACTIVE routes using this next-hop,
	 * so the routing callback must leave the table unchanged.
	 */
	if (all) {
		static const uint8_t retry_payload[] = "ENP-P4-E5C-RETRY";

		const esp_err_t submit = enp_transport_send(
			transport, &s_failed_mac, retry_payload,
			sizeof(retry_payload) - 1U);

		check(submit == ESP_OK,
			  "second real ESP-NOW failure transmission submitted asynchronously",
			  &all);

		vTaskDelay(pdMS_TO_TICKS(1000U));

		check(route_state(&routes, 10U, ENP_ROUTE_STATE_STALE),
			  "repeated real failure kept route A STALE", &all);
		check(route_state(&routes, 11U, ENP_ROUTE_STATE_STALE),
			  "repeated real failure kept route B STALE", &all);
		check(route_state(&routes, 12U, ENP_ROUTE_STATE_ACTIVE),
			  "repeated real failure left unrelated route C ACTIVE", &all);
	}

	if (s_context.transport != NULL) {
		check(enp_context_deinit(&s_context) == ESP_OK,
			  "real ESP-NOW transport deinitialized", &all);
	}

	ESP_LOGI(TAG, "--------------------------------------");

	if (all) {
		ESP_LOGI(TAG,
				 "E3.3.7 Phase 4 / P4-E5C hardware validation PASS");
	} else {
		ESP_LOGE(TAG,
				 "E3.3.7 Phase 4 / P4-E5C hardware validation FAIL");
	}

	ESP_LOGI(TAG, "======================================");

	vTaskDelete(NULL);
}
