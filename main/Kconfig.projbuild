## main/Kconfig.projbuild
```kconfig
menu "ENP - ESP Network Protocol"

choice DEVICE_ROLE

    prompt "Device Role"

    default DEVICE_ROLE_GATEWAY

config DEVICE_ROLE_GATEWAY
    bool "Gateway"
	
config DEVICE_ROLE_RELAY
    bool "Relay"

config DEVICE_ROLE_SENSOR
    bool "Sensor"

endchoice

config ENP_E3_NODE_ID
	int
	default 1
	depends on DEVICE_ROLE_GATEWAY

config ENP_E3_NODE_ID
	int
	default 2
	depends on DEVICE_ROLE_RELAY

config ENP_E3_NODE_ID
	int
	default 3
	depends on DEVICE_ROLE_SENSOR

config ESP_WIFI_SSID
    string "WiFi SSID"

config ESP_WIFI_PASSWORD
    string "WiFi Password"

config GATEWAY_MAC
    string "Gateway MAC Address"
    default "94:e6:86:0d:11:8c"


endmenu
```
